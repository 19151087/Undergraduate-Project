## components/button/Kconfig
```kconfig
menu "Button"

	config BUTTON_MAX
		int "Maximum number of buttons"
		range 1 10
		default 3
	
	config BUTTON_POLL_TIMEOUT
		int "Poll timeout, ms"
		range 1 1000
		default 10

	config BUTTON_LONG_PRESS_TIMEOUT
		int "Timeout of long press, ms"
		range 100 10000
		default 1000

endmenu
```

## components/sd-card/Kconfig.projbuild
```kconfig
menu "SD Card configuration"

    config SD_PIN_MOSI
        int "SDCARD MOSI GPIO Number"
        default 19
        help
            GPIO number for SPI master MOSI.

    config SD_PIN_MISO
        int "SDCARD MISO GPIO Number"
        default 21
        help
            GPIO number for SPI master MISO.

    config SD_PIN_CLK
        int "SDCARD CLK GPIO Number"
        default 18
        help
            GPIO number for SPI master CLK.

    config SD_PIN_CS
        int "SDCARD CS GPIO Number"
        default 5
        help
            GPIO number for SPI master CS.
endmenu
```

## components/sht3x/Kconfig.projbuild
```kconfig
menu "SHT31 configuration"
    config SHT31_I2C_ADDR
        hex "I2C address of SHT31"
        default 0x44
        help
            I2C address of SHT31, either 0x44 or 0x45. When ADDR pin is
            grounded, choose 0x44. When ADDR pin is pulled up to VDD, choose
            0x45.
    
    config SHT31_I2C_PORT
        int "I2C Port"
        default 0
        help
            I2C port for SHT31 sensor.

    config SHT31_I2C_MASTER_SCL
        int "SCL GPIO Number"
        default 5 if IDF_TARGET_ESP8266
        default 6 if IDF_TARGET_ESP32C3
        default 21 if IDF_TARGET_ESP32 || IDF_TARGET_ESP32S2 || IDF_TARGET_ESP32S3
        help
            GPIO number for I2C Master clock line.

    config SHT31_I2C_MASTER_SDA
        int "SDA GPIO Number"
        default 4 if IDF_TARGET_ESP8266
        default 5 if IDF_TARGET_ESP32C3
        default 22 if IDF_TARGET_ESP32 || IDF_TARGET_ESP32S2 || IDF_TARGET_ESP32S3
        help
            GPIO number for I2C Master data line.
endmenu
```

## main/Kconfig.projbuild
```kconfig
menu "PMS7003 configuration"

    config PMS_PIN_TX
        int "TX GPIO Number"
        default 17
        help
            GPIO number for TX.

    config PMS_PIN_RX
        int "RX GPIO Number"
        default 16
        help
            GPIO number for RX.

    config UART_BAUD_RATE
        int "UART baudrate"
        default 9600
        help
            UART baudrate.

    config PMS_UART_PORT
        int "Uart Port"
        default 2
        help
            UART port for PMS sensor.

endmenu

menu "SHT31 configuration"
    config SHT31_I2C_ADDR
        hex "I2C address of SHT31"
        default 0x44
        help
            I2C address of SHT31, either 0x44 or 0x45. When ADDR pin is
            grounded, choose 0x44. When ADDR pin is pulled up to VDD, choose
            0x45.
    
    config SHT31_I2C_PORT
        int "I2C Port"
        default 0
        help
            I2C port for SHT31 sensor.

    config SHT31_I2C_MASTER_SCL
        int "SCL GPIO Number"
        default 5 if IDF_TARGET_ESP8266
        default 6 if IDF_TARGET_ESP32C3
        default 22 if IDF_TARGET_ESP32 || IDF_TARGET_ESP32S2 || IDF_TARGET_ESP32S3
        help
            GPIO number for I2C Master clock line.

    config SHT31_I2C_MASTER_SDA
        int "SDA GPIO Number"
        default 4 if IDF_TARGET_ESP8266
        default 5 if IDF_TARGET_ESP32C3
        default 21 if IDF_TARGET_ESP32 || IDF_TARGET_ESP32S2 || IDF_TARGET_ESP32S3
        help
            GPIO number for I2C Master data line.
endmenu

menu "RTC configuration"

    config RTC_PIN_NUM_SCL
        int "SCL GPIO Number"
        default 27 if IDF_TARGET_ESP32 || IDF_TARGET_ESP32S2 || IDF_TARGET_ESP32S3
        help
            GPIO number for I2C Master clock line.

    config RTC_PIN_NUM_SDA
        int "SDA GPIO Number"
        default 26 if IDF_TARGET_ESP32 || IDF_TARGET_ESP32S2 || IDF_TARGET_ESP32S3
        help
            GPIO number for I2C Master data line.

    config RTC_I2C_PORT
        int "I2C Port"
        default 0
        help 
            I2C port for RTC module.

    config RTC_I2C_FREQ_HZ
        int "Frequency I2C"
        default 400000
        help
            I2C frequency.
endmenu

menu "BUTTON GPIO"

    config EXAMPLE_BUTTON1_GPIO
        int "Button 1 GPIO number"
        default 14 if IDF_TARGET_ESP8266 || IDF_TARGET_ESP32C3
        default 25 if IDF_TARGET_ESP32 || IDF_TARGET_ESP32S2 || IDF_TARGET_ESP32S3
        help
            GPIO number for the first button

    config EXAMPLE_BUTTON2_GPIO
        int "Button 2 GPIO number"
        default 12 if IDF_TARGET_ESP8266 || IDF_TARGET_ESP32C3
        default 26 if IDF_TARGET_ESP32 || IDF_TARGET_ESP32S2 || IDF_TARGET_ESP32S3
        help
            GPIO number for the second button

    config EXAMPLE_BUTTON3_GPIO
        int "Button 3 GPIO number"
        default 12 if IDF_TARGET_ESP8266 || IDF_TARGET_ESP32C3
        default 27 if IDF_TARGET_ESP32 || IDF_TARGET_ESP32S2 || IDF_TARGET_ESP32S3
        help
            GPIO number for the second button
endmenu
```
